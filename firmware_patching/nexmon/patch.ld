MEMORY
{
    ram : ORIGIN = 0x0, LENGTH = 512K
    rom : ORIGIN = 0x800000, LENGTH = 640K
    /* override wlc_recvdata + 4 */
    patch : ORIGIN = 0x12110, LENGTH = 2296
    fpconfig : ORIGIN = 0x5A3A8, LENGTH = 2148
}

SECTIONS
{
    /* include the patch.generated.ld file that was generated by the nexmon gcc plugin after evaluating the "at" attributes */
    INCLUDE flashpatches.generated.ld
    INCLUDE nexmon.generated.ld
}
